## pentair_esp32/sdkconfig.defaults
```kconfig
# Basic settings
CONFIG_FREERTOS_HZ=1000
CONFIG_LOG_DEFAULT_LEVEL_INFO=y
CONFIG_NEWLIB_STDOUT_LINE_ENDING_CRLF=y
CONFIG_NEWLIB_STDIN_LINE_ENDING_CRLF=y
CONFIG_ESP_CONSOLE_UART_NUM=0
CONFIG_ESP_CONSOLE_UART_BAUDRATE=115200

# Wi-Fi
CONFIG_ESP_WIFI_STA_ENABLE=y
CONFIG_ESP_WIFI_NVS_ENABLED=y
CONFIG_ESP_WIFI_SSID="your_ssid"
CONFIG_ESP_WIFI_PASSWORD="your_password"

# NVS (Non-Volatile Storage) for configuration
CONFIG_NVS_ENABLED=y
CONFIG_NVS_ENCRYPTION=n

# mDNS
CONFIG_MDNS_ENABLED=y
CONFIG_MDNS_HOSTNAME="esp-pool-controller"

# HTTP Server (for `esp-idf-svc`)
CONFIG_ESP_HTTPS_SERVER_ENABLE=y

# UART for serial communication
CONFIG_UART_ISR_IN_IRAM=y
CONFIG_UART_SCLK_DEFAULT=y
CONFIG_UART_BITRATE_MAX=115200

# Enable `log` crate support
CONFIG_LOG_ENABLED=y
CONFIG_LOG_MAXIMUM_LEVEL_INFO=y
```
